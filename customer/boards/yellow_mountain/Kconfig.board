## customer/boards/yellow_mountain/lcpu/Kconfig.board
```kconfig
config BSP_USING_BOARD_YELLOW_MOUNTAIN
    bool
    select SOC_SF32LB52X
    select BF0_LCPU
    default y

rsource "../Kconfig.board"
```
